## CMakeLists.txt
```
# Copyright (c) 2026 Codium Electronique
# SPDX-License-Identifier: Apache-2.0

cmake_minimum_required(VERSION 3.20.0)

find_package(Zephyr REQUIRED HINTS $ENV{ZEPHYR_BASE})
project(driver_api)

target_sources(app PRIVATE
    src/main.c
)
```

## Kconfig
```
# Copyright (c) 2026 Codium Electronique
# SPDX-License-Identifier: Apache-2.0

module = OPENER_SAMPLE_DRIVER_API
module-str = Opener DECT NR+ driver API sample
source "$(ZEPHYR_BASE)/subsys/logging/Kconfig.template.log_config"

menu "Zephyr Kernel"
source "Kconfig.zephyr"
endmenu
```

## sample.yaml
```
sample:
  name: driver_api
  description: Demo of the dectnrp driver
tests:
  sample.driver_api:
    platform_allow:
      - nrf9151dk/nrf9151/ns
```

## prj.conf
```kconfig
# Copyright (c) 2026 Codium Electronique
# SPDX-License-Identifier: Apache-2.0

CONFIG_TFM_PROFILE_TYPE_MINIMAL=y

CONFIG_NETWORKING=y
CONFIG_NET_L2_DUMMY=y

CONFIG_HWINFO=y
CONFIG_LOG=y

CONFIG_DECTNRP_DRIVER_BLOCKING_API=y
CONFIG_OPENER_SAMPLE_DRIVER_API_LOG_LEVEL_DBG=y
```

## src/main.c
```c
/*
 * Copyright (c) 2026 Codium Electronique
 * SPDX-License-Identifier: Apache-2.0
 */

#include <zephyr/kernel.h>
#include <zephyr/logging/log.h>

#include <zephyr/net/net_if.h>

#include <opener/build_info.h>

#include <dectnrp/driver.h>

LOG_MODULE_REGISTER(opener_phy_sample, CONFIG_OPENER_SAMPLE_DRIVER_API_LOG_LEVEL);

void dectnrp_l2_init(struct net_if *iface)
{
	LOG_DBG("L2 interface initialized");
	return;
}

int main()
{
	LOG_DBG("Opener version %d.%d.%d-%s%c", OPENER_VERSION_MAJOR, OPENER_VERSION_MINOR,
		OPENER_PATCHLEVEL, STRINGIFY(OPENER_GIT_COMMIT), OPENER_DIRTY ? '+' : '=');

	LOG_DBG("Opener PHY sample started");
	return 0;
}
```
