## CMakeLists.txt
```
# Copyright (c) 2026 Codium Electronique
# SPDX-License-Identifier: Apache-2.0

cmake_minimum_required(VERSION 3.20.0)

find_package(Zephyr REQUIRED HINTS $ENV{ZEPHYR_BASE})
project(dectnrp)

target_sources(app PRIVATE
    src/main.c
)
```

## Kconfig
```
# Copyright (c) 2026 Codium Electronique
# SPDX-License-Identifier: Apache-2.0

module = SAMPLE_DRIVER_DECTNRP
module-str = Opener DECT NR+ driver sample
source "$(ZEPHYR_BASE)/subsys/logging/Kconfig.template.log_config"

menu "Zephyr Kernel"
source "Kconfig.zephyr"
endmenu
```

## sample.yaml
```
sample:
  name: dectnrp
  description: Demo of the dectnrp driver
tests:
  sample.driver_api:
    platform_allow:
      - nrf9151dk/nrf9151/ns
```

## prj.conf
```kconfig
# Copyright (c) 2026 Codium Electronique
# SPDX-License-Identifier: Apache-2.0

CONFIG_TFM_PROFILE_TYPE_MINIMAL=y

CONFIG_NETWORKING=y
CONFIG_NET_L2_DUMMY=y

CONFIG_HWINFO=y
CONFIG_LOG=y

CONFIG_DECTNRP_DRIVER_BLOCKING_API=y
CONFIG_SAMPLE_DRIVER_DECTNRP_LOG_LEVEL_DBG=y
```

## src/main.c
```c
/*
 * Copyright (c) 2026 Codium Electronique
 * SPDX-License-Identifier: Apache-2.0
 */

#include <zephyr/kernel.h>
#include <zephyr/logging/log.h>

#include <zephyr/net/net_if.h>

#include <opener/build_info.h>

#include <zephyr/net/dectnrp/driver.h>

LOG_MODULE_REGISTER(dectnrp, CONFIG_SAMPLE_DRIVER_DECTNRP_LOG_LEVEL);

void dectnrp_l2_init(struct net_if *iface)
{
	LOG_DBG("L2 interface initialized");
	return;
}

int main()
{
	LOG_DBG("Opener version %d.%d.%d-%s%c", OPENER_VERSION_MAJOR, OPENER_VERSION_MINOR,
		OPENER_PATCHLEVEL, STRINGIFY(OPENER_GIT_COMMIT), OPENER_DIRTY ? '+' : '=');

	LOG_DBG("Opener dectnrp driver sample started");
	return 0;
}
```
