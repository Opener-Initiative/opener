## Kconfig
```kconfig
# Copyright (c) 2026 Codium Electronique
# SPDX-License-Identifier: Apache-2.0

rsource "drivers/Kconfig"
rsource "subsys/Kconfig"
```

## drivers/Kconfig
```kconfig
# Copyright (c) 2026 Codium Electronique
# SPDX-License-Identifier: Apache-2.0

rsource "dectnrp/Kconfig"
```

## drivers/dectnrp/Kconfig
```kconfig
# Copyright (c) 2026 Codium Electronique
# SPDX-License-Identifier: Apache-2.0

menu "DECT NR+ driver"

choice DECTNRP_DRIVER_API
    prompt "DECT NR+ driver API"
    help
      Specify the API used by the driver (scheduled or blocking)

config DECTNRP_DRIVER_SCHEDULED_API
    bool "Scheduled API"

config DECTNRP_DRIVER_BLOCKING_API
    bool "Blocking API"

endchoice

rsource "Kconfig.nrf91"

endmenu
```

## drivers/dectnrp/Kconfig.nrf91
```kconfig
# Copyright (c) 2026 Codium Electronique
# Copyright (c) 2026 Deveritec GmbH
# SPDX-License-Identifier: Apache-2.0

config DECTNRP_DRIVER_NRF91
    bool "DECT NR+ nRF91 driver"
    default y
    depends on SOC_SERIES_NRF91X
    depends on NRF_MODEM_LIB
    depends on !MODEM_ANTENNA
    depends on NRF_MODEM_LINK_BINARY_DECT_PHY

if DECTNRP_DRIVER_NRF91

menu "DECTNRP Radio interface"
# Following configs belong to the radio interface.

menu "DECTNRP nRF91 driver capabilities"

config DECTNRP_DRIVER_RDCAP_DECTNRP_RELEASE
	int
	default 1

config DECTNRP_DRIVER_RDCAP_POWERCLASS_MAX
	int
	default 3 if SOC_NRF9161_LACA && DECTNRP_DRIVER_NRF91_BAND_GROUP = 0
	default 3 if SOC_NRF9131_LACA && DECTNRP_DRIVER_NRF91_BAND_GROUP = 0
	default 2 if SOC_NRF9151_LACA && DECTNRP_DRIVER_NRF91_BAND_GROUP = 0
	default 3 if SOC_NRF9151_LACA && DECTNRP_DRIVER_NRF91_BAND_GROUP = 1
	default -1
	range 1 4

config DECTNRP_DRIVER_NRF91_BAND_GROUP
    int
    default 0 if DECTNRP_DRIVER_BAND = 1 || DECTNRP_DRIVER_BAND = 2 || DECTNRP_DRIVER_BAND = 9 || DECTNRP_DRIVER_BAND = 22
    default 1 if DECTNRP_DRIVER_BAND = 4
    default 0

config DECTNRP_DRIVER_RDCAP_NSS_RX_MAX
	int
	default 1

config DECTNRP_DRIVER_RDCAP_RXTX_DIVERSITY_MAX
	int
	default 1

config DECTNRP_DRIVER_RDCAP_RXGAIN_DB
	int
	default -4 

config DECTNRP_DRIVER_RDCAP_MCS_MAX
	int
	default 4

config DECTNRP_DRIVER_RDCAP_SOFTBUFFERSIZE_BYTES_MAX
	int
	default 25344

config DECTNRP_DRIVER_RDCAP_HARQ_PROC_MAX
	int
	default 8

config DECTNRP_DRIVER_RDCAP_HARQ_FEEDBACKDELAY
	int
	default 2

config DECTNRP_DRIVER_RDCAP_MU_MAX
	int
	default 1

config DECTNRP_DRIVER_RDCAP_BETA_MAX
	int
	default 1

config DECTNRP_DRIVER_MODEMTICKS_PER_SYMBOL
	int
	default 2880

endmenu  # "DECTNRP Radio capabilities interface"

endmenu  # "DECTNRP Radio interface"

config DECTNRP_DRIVER_NRF91_CAP_LOGGING
	bool "Enable printing of radio capabilities at startup"
	default n

module = DECTNRP_DRIVER_NRF91
module-str = DECT NR+ NRF91 driver
source "$(ZEPHYR_BASE)/subsys/logging/Kconfig.template.log_config"

endif
```

## subsys/Kconfig
```kconfig
# Copyright (c) 2026 Codium Electronique
# SPDX-License-Identifier: Apache-2.0

rsource "net/l2/dectnrp/Kconfig"
```

## subsys/net/l2/dectnrp/Kconfig
```kconfig
# Copyright (c) 2026 Deveritec GmbH
# SPDX-License-Identifier: Apache-2.0

rsource "Kconfig.radio"
```

## subsys/net/l2/dectnrp/Kconfig.radio
```kconfig
# Copyright (c) 2026 Deveritec GmbH
# SPDX-License-Identifier: Apache-2.0

menu "DECTNRP Radio interface"
# Following configs belong to the radio interface.

menu "DECTNRP Radio capabilities interface"
# Following configs specify hard coded radio capabilities.
# They are meant to be propagated up to L2 layer to control its behaviour.
# The radio driver must override these values.

config DECTNRP_RADIO_RDCAP_DECTNRP_RELEASE
	int
	default 1
	range 1 4
	help
	  DECT NR+ release capability supported by the driver.
	  The radio driver must override this value.

config DECTNRP_RADIO_RDCAP_POWERCLASS_MAX
	int
	default 1
	range 1 4
	help
	  Maximum radio power class supported by the driver.
	  The radio driver must override this value.

config DECTNRP_RADIO_RDCAP_NSS_RX_MAX
	int
	default 1
	range 1 8
	help
	  Maximum number of supported spatial streams supported by the driver.
	  The radio driver must override this value.
	  Supported values: 1, 2, 4, 8

config DECTNRP_RADIO_RDCAP_RXTX_DIVERSITY_MAX
	int
	default 1
	range 1 8
	help
	  The maximum supported RX/TX diversity capability supported by the driver.
	  The radio driver must override this value.
	  Supported values: 1, 2, 4, 8

config DECTNRP_RADIO_RDCAP_RXGAIN_DB
	int
	default 0
	range -10 6
	help
	  Receiver gain capability expressed in dB supported by the driver.
	  The radio driver must override this value.
	  Supported values: -10, -8, -6, -4, -2, 0, 2, 4, 6

config DECTNRP_RADIO_RDCAP_MCS_MAX
	int
	default 11
	range 0 11
	help
	  Maximum supported modulation and coding scheme supported by the driver.
	  The radio driver must override this value.

config DECTNRP_RADIO_RDCAP_SOFTBUFFERSIZE_BYTES_MAX
	int
	default 64000
	range 16000 2048000
	help
	  The maximum supported HARQ soft buffer size in bytes supported by the driver.
	  The radio driver must override this value.
	  Supported values: 16000, 25344, 32000, 64000, 128000, 256000, 512000,
	  1024000, 2048000

config DECTNRP_RADIO_RDCAP_HARQ_PROC_MAX
	int
	default 1
	range 1 8
	help
	  Maximum number of HARQ processes supported by the driver.
	  The radio driver must override this value.
	  Supported values: 1, 2, 4, 8

config DECTNRP_RADIO_RDCAP_HARQ_FEEDBACKDELAY
	int
	default 3
	range 0 6
	help
	  HARQ feedback delay in frames supported by the driver.
	  The radio driver must override this value.

config DECTNRP_RADIO_RDCAP_MU_MAX
	int
	default 1
	range 1 8
	help
	  Maximum subcarrier scaling factor mu(µ) supported by the driver.
	  The radio driver must override this value.
	  Supported values: 1, 2, 4, 8

config DECTNRP_RADIO_RDCAP_BETA_MAX
	int
	default 1
	range 1 16
	help
	  Maximum fourier transform scaling factor beta(β) supported by the driver.
	  The radio driver must override this value.
	  Supported values: 1, 2, 4, 8, 12, 16

config DECTNRP_RADIO_RDCAP_SYNC_IN
	bool
	help
	  Flag marking support for synchronization input GPIO.

config DECTNRP_RADIO_RDCAP_SYNC_OUT
	bool
	help
	  Flag marking support for synchronization output GPIO.

config DECTNRP_RADIO_MODEMTICKS_PER_SYMBOL
	int 
	default 1
	help
	  Number of modem ticks that represent a single OFDM symbol.
	  The radio driver must override this value.

endmenu  # "DECTNRP Radio capabilities interface"

menu "DECTNRP Radio control interface"
# Following configs specify hard coded control switches for the radio.
# They are meant to be propagated down to radio to control its behaviour.
# The radio driver must use these values.

endmenu  # "DECTNRP Radio control interface"

endmenu  # "DECTNRP Radio interface"
```
